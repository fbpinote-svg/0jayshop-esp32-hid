## firmware/sdkconfig.defaults
```kconfig
CONFIG_IDF_TARGET="esp32s3"
CONFIG_ESP_DEFAULT_CPU_FREQ_MHZ_240=y
CONFIG_LOG_DEFAULT_LEVEL_NONE=y
CONFIG_ESP_CONSOLE_NONE=y
CONFIG_ESP_CONSOLE_SECONDARY_NONE=y
CONFIG_TINYUSB=y
CONFIG_TINYUSB_HID_ENABLED=y
# CONFIG_TINYUSB_DESC_USE_DEFAULT_PID is not set
CONFIG_TINYUSB_DESC_CUSTOM_PID=0x4004
CONFIG_TINYUSB_DESC_PRODUCT_STRING="ESP32-S3 Max HID"
CONFIG_TINYUSB_DESC_SERIAL_STRING="ESP32S3-MAX-HID"
CONFIG_TINYUSB_HID_COUNT=3
CONFIG_COMPILER_OPTIMIZATION_SIZE=y
CONFIG_LIBC_NEWLIB=y
```
